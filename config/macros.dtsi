macro_shift_opt_cmd: macro_shift_opt_cmd{
compatible = "zmk,behavior-macro";
label = "macro_shift_opt_cmd";
#binding-cells = <0>;
bindings = <&mt LS(LA(LGUI)) END>;
};
macro_ctrl_opt: macro_ctrl_opt{
compatible = "zmk,behavior-macro";
label = "macro_ctrl_opt";
#binding-cells = <0>;
bindings = <&mt LC(LALT) HOME>;
};